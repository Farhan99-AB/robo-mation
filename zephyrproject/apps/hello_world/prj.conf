## prj.conf
```kconfig
# nothing here
CONFIG_BOOTLOADER_MCUBOOT = y
```

## src/main.c
```c
/*
 * Copyright (c) 2012-2014 Wind River Systems, Inc.
 *
 * SPDX-License-Identifier: Apache-2.0
 */

#include <stdio.h>

int main(void)
{
	printf("Hello World FARHAN GANESH VARAD! %s\n", CONFIG_BOARD_TARGET);

	return 0;
}
```
