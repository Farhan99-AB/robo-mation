## zephyrproject/build/Kconfig/boards/Kconfig.defconfig
```kconfig
# Load Zephyr board defconfig descriptions.
osource "D:/GIT_Repo/robo-mation/zephyrproject/zephyr/boards/espressif/esp32_devkitc/Kconfig.defconfig"
```

## zephyrproject/build/Kconfig/boards/Kconfig.esp32_devkitc
```kconfig
# Load board Kconfig descriptions.
osource "D:/GIT_Repo/robo-mation/zephyrproject/zephyr/boards/espressif/esp32_devkitc/Kconfig.esp32_devkitc"
```

## zephyrproject/build/chatterbox/Kconfig/boards/Kconfig.sysbuild
```kconfig
# Load Sysbuild board Kconfig descriptions.
osource "D:/GIT_Repo/robo-mation/zephyrproject/zephyr/boards/espressif/esp32_devkitc/Kconfig.sysbuild"
```

## zephyrproject/build/mcuboot/Kconfig/arch/Kconfig
```kconfig
# Load Zephyr Arch Kconfig descriptions.
osource "D:/GIT_Repo/robo-mation/zephyrproject/zephyr/arch/rx/Kconfig"
osource "D:/GIT_Repo/robo-mation/zephyrproject/zephyr/arch/x86/Kconfig"
osource "D:/GIT_Repo/robo-mation/zephyrproject/zephyr/arch/xtensa/Kconfig"
osource "D:/GIT_Repo/robo-mation/zephyrproject/zephyr/arch/sparc/Kconfig"
osource "D:/GIT_Repo/robo-mation/zephyrproject/zephyr/arch/riscv/Kconfig"
osource "D:/GIT_Repo/robo-mation/zephyrproject/zephyr/arch/posix/Kconfig"
osource "D:/GIT_Repo/robo-mation/zephyrproject/zephyr/arch/mips/Kconfig"
osource "D:/GIT_Repo/robo-mation/zephyrproject/zephyr/arch/arm64/Kconfig"
osource "D:/GIT_Repo/robo-mation/zephyrproject/zephyr/arch/arm/Kconfig"
osource "D:/GIT_Repo/robo-mation/zephyrproject/zephyr/arch/arc/Kconfig"
```
